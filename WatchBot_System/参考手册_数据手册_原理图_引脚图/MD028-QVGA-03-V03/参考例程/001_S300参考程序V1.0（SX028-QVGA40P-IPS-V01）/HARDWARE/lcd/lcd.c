#include <stdio.h>
#include <string.h>
#include "sys.h"
#include "delay.h"
#include "usart.h"
#include "flash.h"
#include "main.h"
#include "lcd.h"
#include "interface.h"
//=========================================
// 函数: void LCD_GPIOInit(void)
// 描述: LCD 相关的GPIO设定
//=========================================
void LCD_GPIOInit(void)
{
	GPIO_InitTypeDef GPIO_InitStructure;
	//RCC_APB2PeriphClockCmd(RCC_APB2Periph_GPIOA|RCC_APB2Periph_GPIOC|RCC_APB2Periph_GPIOB|RCC_APB2Periph_GPIOD|RCC_APB2Periph_AFIO, ENABLE); //B
 	RCC_APB2PeriphClockCmd(RCC_APB2Periph_GPIOA|RCC_APB2Periph_GPIOC|RCC_APB2Periph_GPIOB|RCC_APB2Periph_GPIOD, ENABLE); //B
	GPIO_PinRemapConfig(GPIO_Remap_SWJ_JTAGDisable , ENABLE);
	
	GPIO_InitStructure.GPIO_Pin = GPIO_Pin_10|GPIO_Pin_7|GPIO_Pin_6|GPIO_Pin_5|GPIO_Pin_4|GPIO_Pin_3|GPIO_Pin_1;	   //GPIO_Pin_10
	GPIO_InitStructure.GPIO_Mode = GPIO_Mode_Out_PP;  //
	GPIO_InitStructure.GPIO_Speed = GPIO_Speed_50MHz;
	GPIO_Init(GPIOC, &GPIO_InitStructure); //GPIOC	
	GPIO_SetBits(GPIOC,GPIO_Pin_7|GPIO_Pin_6|GPIO_Pin_5|GPIO_Pin_4|GPIO_Pin_3);
	GPIO_SetBits(GPIOC,GPIO_Pin_7);

	GPIO_InitStructure.GPIO_Pin = GPIO_Pin_0|GPIO_Pin_2|GPIO_Pin_14|GPIO_Pin_15;	   //GPIO_Pin_0
	GPIO_InitStructure.GPIO_Mode = GPIO_Mode_Out_PP;  //
	GPIO_InitStructure.GPIO_Speed = GPIO_Speed_50MHz;
	GPIO_Init(GPIOA, &GPIO_InitStructure); //	

	GPIO_InitStructure.GPIO_Pin = GPIO_Pin_2;	   //
	GPIO_InitStructure.GPIO_Mode = GPIO_Mode_Out_PP;  //
	GPIO_InitStructure.GPIO_Speed = GPIO_Speed_50MHz;
	GPIO_Init(GPIOD, &GPIO_InitStructure); //	
	GPIO_SetBits(GPIOD,GPIO_Pin_2);
//	GPIO_ResetBits(GPIOD,GPIO_Pin_2);

	GPIO_InitStructure.GPIO_Pin = GPIO_Pin_All;	//  
	GPIO_Init(GPIOB, &GPIO_InitStructure); //GPIOB   B
	GPIO_SetBits(GPIOB,GPIO_Pin_All);	

	GPIO_InitStructure.GPIO_Pin = (GPIO_Pin_11|GPIO_Pin_9|GPIO_Pin_2|GPIO_Pin_1|GPIO_Pin_0);	//  
	GPIO_InitStructure.GPIO_Mode = GPIO_Mode_IPU;  //输入
	GPIO_InitStructure.GPIO_Speed = GPIO_Speed_50MHz;  
	GPIO_Init(GPIOC, &GPIO_InitStructure); //
}
//struct LCD_CONFIG lcdconfig;
LCD_CONFIG lcdconfig;
//=============================================================
// 函数: void LCD_CONFIG_INIT(void)
// 描述: LCD设置初始化
//=============================================================
void LCD_CONFIG_INIT(void)
{
	lcdconfig.col=COL;
	lcdconfig.row=ROW;
	lcdconfig.col_pre=COL_Pre;
	lcdconfig.row_pre=ROW_Pre;
	#ifdef LCD_MCU8
	lcdconfig.lcd_interface=MCU8;
	#endif
	#ifdef LCD_MCU16
	lcdconfig.lcd_interface=MCU16;
	#endif
	#ifdef LCD_MCUH8
	lcdconfig.lcd_interface=MCUH8;
	#endif
	#ifdef LCD_SPI4Line
	lcdconfig.lcd_interface=SPI4Line;
	#endif
	#ifdef LCD_SPI3Line
	lcdconfig.lcd_interface=SPI3Line;
	#endif
	#ifdef LCD_SPI3Line2
	lcdconfig.lcd_interface=SPI3Line2;
	#endif
	#ifdef LCD_SPI4Line_CS_D8
	lcdconfig.lcd_interface=SPI4Line_CS_D8;
	#endif
	lcdconfig.delay_time=Delay_Time;
	#ifdef commdata16
	lcdconfig.is_commdata16=1;
	#else
	lcdconfig.is_commdata16=0;
	#endif
	#ifdef TEST_STAND_H9B
	lcdconfig.pic_bytes=(COL*ROW)*3;
	#else
	lcdconfig.pic_bytes=(COL*ROW)<<1;
	#endif
}
//=============================================================
// 函数: void LCD_RESET(void)
// 描述: LCD 复位操作
// 注意事项：
// 申明：   （2008-2023 版权所有，盗版必究）
//=============================================================
void LCD_RESET(void)
{
	LCD_RST_SET;
	delay_ms(50);
	LCD_RST_CLR;
	delay_ms(200);	
	LCD_RST_SET;
	delay_ms(200);
}
//=============================================================
/* 函数: void LCD_Init(void)
   描述: 对LCD进行初始化
   注意事项：
   申明：（2008-2023 版权所有，盗版必究）*/
//=============================================================
void LCD_Init(void)
{
	LCD_GPIOInit();
	LCD_CONFIG_INIT();	//LCD参数设置初始化
	LCD_RESET();
	LCD_IC_Init();
//=============================================================
}

//=============================================================
/* 函数: void WriteOneDot(unsigned int color)
   描述: 写单个点
   注意事项：
   申明：（2008-2023 版权所有，盗版必究）*/
//=============================================================
void WriteOneDot(unsigned int color)
{
	LCD_CS_CLR;
	LCD_RD_SET;
	LCD_RS_SET;
	SendData(color);
	LCD_CS_SET;
}
void WriteDispData(unsigned int color1,unsigned int color2)
{
	SendData(color1);
	SendData(color2);
}
void DispColor(unsigned int color)
{
	unsigned int i,j;
	BlockWrite(COL_Pre,COL+COL_Pre-1,ROW_Pre,ROW+ROW_Pre-1);
	LCD_CS_CLR;
	LCD_RS_SET;
	LCD_RD_SET;
		for(i=0;i<ROW;i++)
		{
		  for(j=0;j<COL;j++)
			{    
				SendData(color);
			}
		}
		LCD_CS_SET;
}	
void DispBand(void)	 
{
	int i,j,k;
	//unsigned int color[8]={0x001f,0x07e0,0xf800,0x07ff,0xf81f,0xffe0,0x0000,0xffff};
	unsigned int color[8]={0xf800,0xf800,0x07e0,0x07e0,0x001f,0x001f,0xffff,0xffff};//0x94B2
	//unsigned int gray16[]={0x0000,0x1082,0x2104,0x3186,0x42,0x08,0x528a,0x630c,0x738e,0x7bcf,0x9492,0xa514,0xb596,0xc618,0xd69a,0xe71c,0xffff};
  BlockWrite(COL_Pre,COL+COL_Pre-1,ROW_Pre,ROW+ROW_Pre-1);
	LCD_CS_CLR;
	LCD_RD_SET;
	LCD_RS_SET;																									  
	for(i=0;i<8;i++)
	{
		for(j=0;j<ROW/8;j++)
		{
	    for(k=0;k<COL;k++)
			{
				SendData(color[i]); 
			} 
		}
	}
	for(j=0;j<ROW%8;j++)
	{
		for(k=0;k<COL;k++)
		{
			SendData(color[7]); 
		} 
	}
	LCD_CS_SET;
}
//==========================================
void DispFrame(void)
{
	unsigned int i,j;
	BlockWrite(COL_Pre,COL+COL_Pre-1,ROW_Pre,ROW+ROW_Pre-1);
	LCD_CS_CLR;
	LCD_RS_SET;
	LCD_RD_SET;
	SendData(0xf800);
	for(i=0;i<COL-2;i++){SendData(0xFFFF);}
	SendData(0x001f);
	for(j=0;j<ROW-2;j++)
	{
		SendData(0xf800);
		for(i=0;i<COL-2;i++){SendData(0x0000);}
		SendData(0x001F);
	}
	SendData(0xf800);
	for(i=0;i<COL-2;i++){SendData(0xFFFF);}
	SendData(0x001F);
	LCD_CS_SET;
}
void DispGrayHor16(void)	 
{
	int i,j,k;
  BlockWrite(COL_Pre,COL+COL_Pre-1,ROW_Pre,ROW+ROW_Pre-1);
	LCD_CS_CLR;
	LCD_RD_SET;
	LCD_RS_SET;																									  
	for(i=0;i<ROW;i++)
	{
		for(j=0;j<COL%16;j++)
		{
			SendData(0);
		}
		for(j=0;j<16;j++)
		{
	    for(k=0;k<COL/16;k++)
			{		
				SendData(((((j*2)<<3)|((j*4)>>3))<<8)|(((j*4)<<5)|(j*2)));	
			} 
		}
	}
	LCD_CS_SET; 
}
//==============================================
#ifdef TEST_STAND_H9B
void DispColor_9bit_window(unsigned char r,unsigned char g,unsigned char b)
{
	unsigned int i,j;
  int data_first_9bit,data_second_9bit;
  BlockWrite(COL_Pre,COL+COL_Pre-1,ROW_Pre,ROW+ROW_Pre-1);
	LCD_CS_CLR;
	LCD_RS_SET;
	LCD_RD_SET;
	data_first_9bit=((r&0xfc)<<2)|(((g&0xfc)>>4)&0x07);
	data_second_9bit=(((g&0x00fc)<<4)&0x1c0)|(((b&0x00fc)>>2)&0x3f);
	for(i=0;i<ROW;i++)
	{
	  for(j=0;j<COL;j++)
		{    
			DATAOUT(data_first_9bit);
			LCD_WR_CLR;
			LCD_WR_SET;
        
			 DATAOUT(data_second_9bit);
			 LCD_WR_CLR;
			 LCD_WR_SET;
		//	delay_ms(10);
		}
	}
	LCD_CS_SET;
}
void DispBand_9b(void)	 
{
	int i,j,k;
	unsigned int color[8]={0xfC00,0xfC00,0x07e0,0x07e0,0x003f,0x003f,0xffff,0xffff};//0x94B2
  BlockWrite(COL_Pre,COL+COL_Pre-1,ROW_Pre,ROW+ROW_Pre-1);
	LCD_CS_CLR;
	LCD_RD_SET;
	LCD_RS_SET;																									  
	for(i=0;i<8;i++)
	{
		for(j=0;j<ROW/8;j++)
		{
	    for(k=0;k<COL;k++)
			{
				SendData(color[i]); 
			} 
		}
	}
	for(j=0;j<ROW%8;j++)
	{
		for(k=0;k<COL;k++)
		{
			SendData(color[7]); 
		} 
	}
	LCD_CS_SET;
}
void DispFrame_9b(void) 
{
	unsigned int i,j;
	
	BlockWrite(COL_Pre,COL+COL_Pre-1,ROW_Pre,ROW+ROW_Pre-1);

	LCD_CS_CLR;
	LCD_RS_SET;
	LCD_RD_SET;
		
	SendData(0xFC00);
	for(i=0;i<COL-2;i++){SendData(0xFFFF);}
	SendData(0x003F);

	for(j=0;j<ROW-2;j++)
	{
		SendData(0xFC00);
		for(i=0;i<COL-2;i++){SendData(0x0000);}
		SendData(0x003F);
	}
	
	SendData(0xFC00);
	for(i=0;i<COL-2;i++){SendData(0xFFFF);}
	SendData(0x003F);
	
	LCD_CS_SET;
}
void DispGrayHor16_9b(void)	 
{
	int i,j,k;
	unsigned int data_first_9bit,data_second_9bit;
	u8 data_r,data_g,data_b;

	BlockWrite(COL_Pre,COL+COL_Pre-1,ROW_Pre,ROW+ROW_Pre-1);
    	
	LCD_CS_CLR;
	LCD_RD_SET;
	LCD_RS_SET;																									  

	for(i=0;i<ROW;i++)
	{
		for(j=0;j<COL%16;j++)
		{
			SendData(0);
		}
		for(j=0;j<16;j++)
		{
			data_r=j*15;
			data_g=data_b=data_r;
	    for(k=0;k<COL/16;k++)
			{	
//				SendData(((((j*2)<<3)|((j*4)>>3))<<8)|(((j*4)<<5)|(j*2)));	
				data_first_9bit=(((data_r&0xfc)<<8)|(((data_g&0xe0)<<2)));
				data_second_9bit=(((data_g&0x1c)<<11)|((data_b&0x00fc)<<5));	
				
				DATAOUT(data_first_9bit);
				LCD_WR_CLR;
				LCD_WR_SET;
				
				DATAOUT(data_second_9bit);
				LCD_WR_CLR;
				LCD_WR_SET;
			} 
		}
	}
	LCD_CS_SET;
}
 void TEST_STAND_9b(void)
 {
	  DispFrame_9b();
	  StopDelay(Delay_Time);
		Disp_Flash_Pic_9b_Num(0);  	//显示图片
		StopDelay(Delay_Time);
		DispBand_9b();		
		StopDelay(Delay_Time);
		DispColor(0xFC00);	//红
		StopDelay(Delay_Time);
		DispColor(GREEN);		//绿
		StopDelay(Delay_Time);
		DispColor(0x003f);	//蓝
		StopDelay(Delay_Time);
		DispColor(WHITE);
		StopDelay(Delay_Time);
		DispColor(BLACK);
		StopDelay(Delay_Time);
	  DispChess(16);
	  StopDelay(Delay_Time);
}

#endif
void DispGrayHor32(void)	 
{
	int i,j,k;
  BlockWrite(COL_Pre,COL+COL_Pre-1,ROW_Pre,ROW+ROW_Pre-1);
	LCD_CS_CLR;
	LCD_RD_SET;
	LCD_RS_SET;																									  

	for(i=0;i<ROW;i++)
	{
		for(j=0;j<COL%32;j++)
		{
			SendData(0);
		}
		for(j=0;j<32;j++)
		{
	    for(k=0;k<COL/32;k++)
			{		
				SendData(((((j<<3)|((j*2)>>3)))<<8)|(((j*2)<<5)|j));	
			} 
		}
	}
	LCD_CS_SET;
}
#if 1 //TP_TEST
void PutPixel(unsigned int x,unsigned int y,unsigned int color)	//TP drawing dots
{
	int i;
	BlockWrite(x,x+3,y,y+3);

	LCD_CS_CLR;
	LCD_RD_SET;
	LCD_RS_SET;	
	
	for(i=0;i<16;i++)
	{
    DATAOUT(color);  
		LCD_WR_CLR;
		LCD_WR_SET; 
	}
	LCD_CS_SET; 
}
void DrawLine(unsigned int Xstart,unsigned int Xend,unsigned int Ystart,unsigned int Yend,unsigned int color)
{
	unsigned int i,j;

	BlockWrite(Xstart,Xend,Ystart,Yend);

	for(i=Ystart;i<Yend+1;i++)
	{
		for(j=Xstart;j<Xend+1;j++)
		{
			WriteOneDot(color);
		}
	}
}
void DrawGird(unsigned int color)
{
	unsigned int i;

	for(i=15;i<ROW-1;i=i+16)
	{
		DrawLine(0,COL-1,i,i,color);
	}

	for(i=15;i<COL-1;i=i+16)
	{
		DrawLine(i,i,0,ROW-1,color);
	}
}
#endif
void DispQiPan(void)
{
	unsigned int i,j;
	BlockWrite(COL_Pre,COL-1+COL_Pre,ROW_Pre,ROW-1+ROW_Pre);
		
	for(j=0;j<ROW;j++)
	{
		for(i=0;i<COL;i++){
			if(i % 4==0)
			WriteOneDot(0xFFFF);
			else
			WriteOneDot(0x0000);
		}
	}
}
void DispBlock(void)
{
    unsigned int i,j,k;

    k = ROW /4;
    
		BlockWrite(COL_Pre,COL-1+COL_Pre,ROW_Pre,ROW-1+ROW_Pre);

		LCD_CS_CLR;
		LCD_RD_SET;
		LCD_RS_SET;																									  
		
	for(i=0;i<k;i++)
	{
    for(j=0;j<COL;j++)
		{
			WriteDispData(0x7b,0xef);  
		}
	}
	for(i=0;i<k*2;i++)
	{
		for(j=0;j<COL/4;j++)
		{
			WriteDispData(0x7b,0xef);  
		}
		for(j=0;j<COL/2;j++)
		{
			WriteDispData(0,0);  
		}
		for(j=0;j<COL/4;j++)
		{
			WriteDispData(0x7b,0xef);  
		}
	}
	for(i=0;i<k;i++)
	{
    for(j=0;j<COL;j++)
		{
			WriteDispData(0x7b,0xef);  
		}
	}
		LCD_CS_SET;																									  
}
#ifdef String_Enable

//12*12 ASCII字符集点阵
const unsigned char asc2_1206[95][12]={
{0x00,0x00,0x00,0x00,0x00,0x00,0x00,0x00,0x00,0x00,0x00,0x00},/*" ",0*/
{0x00,0x00,0x00,0x00,0x3F,0x40,0x00,0x00,0x00,0x00,0x00,0x00},/*"!",1*/
{0x00,0x00,0x30,0x00,0x40,0x00,0x30,0x00,0x40,0x00,0x00,0x00},/*""",2*/
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{0x40,0x00,0x80,0x00,0x40,0x00,0x20,0x00,0x20,0x00,0x40,0x00},/*"~",94*/
};
//16*16 ASCII字符集点阵
const unsigned char asc2_1608[95][16]={	  
{0x00,0x00,0x00,0x00,0x00,0x00,0x00,0x00,0x00,0x00,0x00,0x00,0x00,0x00,0x00,0x00},/*" ",0*/
{0x00,0x00,0x00,0x00,0x00,0x00,0x1F,0xCC,0x00,0x0C,0x00,0x00,0x00,0x00,0x00,0x00},/*"!",1*/
{0x00,0x00,0x08,0x00,0x30,0x00,0x60,0x00,0x08,0x00,0x30,0x00,0x60,0x00,0x00,0x00},/*""",2*/
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{0x00,0x00,0x60,0x00,0x80,0x00,0x80,0x00,0x40,0x00,0x40,0x00,0x20,0x00,0x20,0x00},/*"~",94*/
};  
//24*24 ASICII字符集点阵
const unsigned char asc2_2412[95][36]={	  
{0x00,0x00,0x00,0x00,0x00,0x00,0x00,0x00,0x00,0x00,0x00,0x00,0x00,0x00,0x00,0x00,0x00,0x00,0x00,0x00,0x00,0x00,0x00,0x00,0x00,0x00,0x00,0x00,0x00,0x00,0x00,0x00,0x00,0x00,0x00,0x00},/*" ",0*/
{0x00,0x00,0x00,0x00,0x00,0x00,0x00,0x00,0x00,0x00,0x00,0x00,0x00,0x00,0x00,0x0F,0x80,0x38,0x0F,0xFE,0x38,0x0F,0x80,0x38,0x00,0x00,0x00,0x00,0x00,0x00,0x00,0x00,0x00,0x00,0x00,0x00},/*"!",1*/
{0x00,0x00,0x00,0x00,0x00,0x00,0x01,0x00,0x00,0x06,0x00,0x00,0x0C,0x00,0x00,0x38,0x00,0x00,0x31,0x00,0x00,0x06,0x00,0x00,0x0C,0x00,0x00,0x38,0x00,0x00,0x30,0x00,0x00,0x00,0x00,0x00},/*""",2*/
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{0x00,0x00,0x00,0x18,0x00,0x00,0x60,0x00,0x00,0x40,0x00,0x00,0x40,0x00,0x00,0x20,0x00,0x00,0x10,0x00,0x00,0x08,0x00,0x00,0x04,0x00,0x00,0x04,0x00,0x00,0x0C,0x00,0x00,0x10,0x00,0x00},/*"~",94*/
};  
void LCD_ShowChar(u16 x,u16 y,u8 num,u8 size,u8 mode)
{  							  
	u8 temp,t1,t;
	u16 y0=y;
	u8 csize=(size/8+((size%8)?1:0))*(size/2);		//得到字体一个字符对应点阵集所占的字节数	
 	num=num-' ';//得到偏移后的值（ASCII字库是从空格开始取模，所以-' '就是对应字符的字库）
	for(t=0;t<csize;t++)
	{   
		if(size==12)temp=asc2_1206[num][t]; 	 	//调用1206字体
		else if(size==16)temp=asc2_1608[num][t];	//调用1608字体
		else if(size==24)temp=asc2_2412[num][t];	//调用2412字体
		else return;								//没有的字库
		for(t1=0;t1<8;t1++)  //８个点
		{			    
			if(temp&0x80)LCD_Fast_DrawPoint(x,y,POINT_COLOR);
			else if(mode==0)LCD_Fast_DrawPoint(x,y,BACK_COLOR);
			temp<<=1;
			y++;       ////刷下一行 ，注意：PC2LCD2002取模方式设置：阴码+逐列式+顺向+C51格式　20180419
			if(y>=ROW)return;		//超区域了
			if((y-y0)==size)   //刷满一个字符高度时20180419
			{
				y=y0;  //回到第一行20180419
				x++;   //开刷下一列20180419
				if(x>=COL)return;	//超区域了
				break;
			}
		}  	 
	}  	    	   	 	  
}  
void LCD_Fast_DrawPoint(unsigned short x,unsigned short y,unsigned short color)
{	  
	LCD_SetCursor(x,y);	
	WriteOneDot(color);				
}
void LCD_ShowString(u16 x,u16 y,u16 width,u16 height,u8 size,u8 *p)
{ 
	u8 x0=x;
	width+=x;
	height+=y;
    while((*p<='~')&&(*p>=' '))//判断是不是非法字符!
    {       
        if(x>=width){x=x0;y+=size;}
        if(y>=height)break;//退出
        LCD_ShowChar(x,y,*p,size,0);
        x+=size/2;
        p++;
    }  
}
u16 POINT_COLOR = RED,BACK_COLOR = 0xFFFF;  //画笔颜色,背景颜色
void LCD_WriteRAM(u16 RGB_Code)
{
	WriteData(RGB_Code);
}
void LCD_SetCursor(unsigned short Xpos, unsigned short Ypos)
{	 	
	BlockWrite(Xpos,Xpos+1,Ypos,Ypos+1);
}
void LCD_DrawPoint(u16 x,u16 y)
{
	LCD_SetCursor(x,y);		//设置光标位置 
	WriteOneDot(POINT_COLOR);
//	LCD->LCD_RAM=POINT_COLOR; 
}
#endif
