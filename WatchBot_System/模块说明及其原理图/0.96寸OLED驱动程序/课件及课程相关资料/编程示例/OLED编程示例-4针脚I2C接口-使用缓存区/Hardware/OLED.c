#include "stm32f10x.h"                  // Device header
#include "MyI2C.h"
#include "Delay.h"
#include "OLED.h"
#include <string.h>
#include <math.h>

/*ASCII字模数据*********************/

/*宽8像素，高16像素*/
const uint8_t OLED_F8x16[][16] =
{
	0x00,0x00,0x00,0x00,0x00,0x00,0x00,0x00,
	0x00,0x00,0x00,0x00,0x00,0x00,0x00,0x00,//   0
	0x00,0x00,0x00,0xF8,0x00,0x00,0x00,0x00,
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	0x00,0x00,0x00,0x00,0x00,0x01,0x01,0x00,// ~ 94
};

/*宽6像素，高8像素*/
const uint8_t OLED_F6x8[][6] = 
{
	0x00,0x00,0x00,0x00,0x00,0x00,//   0
	0x00,0x00,0x00,0x2F,0x00,0x00,// ! 1
	0x00,0x00,0x07,0x00,0x07,0x00,// " 2
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	0x00,0x08,0x04,0x08,0x10,0x08,// ~ 94
};
/*********************ASCII字模数据*/

typedef struct {
	char Index[4];
	uint8_t Data[32];
} ChineseCell_t;

const ChineseCell_t OLED_CF16x16[] = {
	
	"你",
	0x00,0x80,0x60,0xF8,0x07,0x40,0x20,0x18,0x0F,0x08,0xC8,0x08,0x08,0x28,0x18,0x00,
	0x01,0x00,0x00,0xFF,0x00,0x10,0x0C,0x03,0x40,0x80,0x7F,0x00,0x01,0x06,0x18,0x00,/*0*/

	"好",
	0x10,0x10,0xF0,0x1F,0x10,0xF0,0x00,0x80,0x82,0x82,0xE2,0x92,0x8A,0x86,0x80,0x00,
	0x40,0x22,0x15,0x08,0x16,0x61,0x00,0x00,0x40,0x80,0x7F,0x00,0x00,0x00,0x00,0x00,/*1*/

	"世",
	0x20,0x20,0x20,0xFE,0x20,0x20,0xFF,0x20,0x20,0x20,0xFF,0x20,0x20,0x20,0x20,0x00,
	0x00,0x00,0x00,0x7F,0x40,0x40,0x47,0x44,0x44,0x44,0x47,0x40,0x40,0x40,0x00,0x00,/*2*/

	"界",
	0x00,0x00,0x00,0xFE,0x92,0x92,0x92,0xFE,0x92,0x92,0x92,0xFE,0x00,0x00,0x00,0x00,
	0x08,0x08,0x04,0x84,0x62,0x1E,0x01,0x00,0x01,0xFE,0x02,0x04,0x04,0x08,0x08,0x00,/*3*/
	
	//...
	
	"",
	0xFF,0xFF,0xFF,0xFF,0xFF,0xFF,0xFF,0xFF,0xFF,0xFF,0xFF,0xFF,0xFF,0xFF,0xFF,0xFF,
	0xFF,0xFF,0xFF,0xFF,0xFF,0xFF,0xFF,0xFF,0xFF,0xFF,0xFF,0xFF,0xFF,0xFF,0xFF,0xFF,
};



uint8_t OLED_DisplayBuf[8][128];

void OLED_WriteCommand(uint8_t Command)
{
	MyI2C_Start();
	MyI2C_SendByte(0x78);		//寻址
	MyI2C_ReceiveAck();
	MyI2C_SendByte(0x00);		//Control Byte
	MyI2C_ReceiveAck();
	MyI2C_SendByte(Command);	//Data Byte
	MyI2C_ReceiveAck();
	MyI2C_Stop();
}

void OLED_WriteData(uint8_t *Data, uint8_t Count)
{
	MyI2C_Start();
	MyI2C_SendByte(0x78);		//寻址
	MyI2C_ReceiveAck();
	MyI2C_SendByte(0x40);		//Control Byte
	MyI2C_ReceiveAck();
	for (uint8_t i = 0; i < Count; i ++)
	{
		MyI2C_SendByte(Data[i]);	//Data Byte
		MyI2C_ReceiveAck();
	}
	MyI2C_Stop();
}

void OLED_Init(void)
{
	MyI2C_Init();
	
	Delay_ms(100);
	
	OLED_WriteCommand(0xAE);
	
	OLED_WriteCommand(0xD5);
	OLED_WriteCommand(0x80);
	
	OLED_WriteCommand(0xA8);
	OLED_WriteCommand(0x3F);
	
	OLED_WriteCommand(0xD3);
	OLED_WriteCommand(0x00);
	
	OLED_WriteCommand(0x40);
	
	OLED_WriteCommand(0xA1);
	
	OLED_WriteCommand(0xC8);

	OLED_WriteCommand(0xDA);
	OLED_WriteCommand(0x12);
	
	OLED_WriteCommand(0x81);
	OLED_WriteCommand(0xCF);

	OLED_WriteCommand(0xD9);
	OLED_WriteCommand(0xF1);

	OLED_WriteCommand(0xDB);
	OLED_WriteCommand(0x30);

	OLED_WriteCommand(0xA4);

	OLED_WriteCommand(0xA6);

	OLED_WriteCommand(0x8D);
	OLED_WriteCommand(0x14);

	OLED_WriteCommand(0xAF);
	
	Delay_ms(100);
}

void OLED_SetCursor(uint8_t X, uint8_t Page)
{
	OLED_WriteCommand(0x00 | (X & 0x0F));
	OLED_WriteCommand(0x10 | ((X & 0xF0) >> 4));
	OLED_WriteCommand(0xB0 | Page);
}

void OLED_Update(void)
{
	for (uint8_t j = 0; j < 8; j ++)
	{
		OLED_SetCursor(0, j);
		OLED_WriteData(OLED_DisplayBuf[j], 128);
	}
}

void OLED_Clear(void)
{
	for (uint8_t j = 0; j < 8; j ++)
	{
//		OLED_SetCursor(0, j);
		for (uint8_t i = 0; i < 128; i ++)
		{
//			OLED_WriteData(0x00);
			OLED_DisplayBuf[j][i] = 0x00;
		}
	}
}

void OLED_ClearArea(uint8_t X, uint8_t Y, uint8_t Width, uint8_t Height)
{
	for (uint8_t j = Y; j < Y + Height; j ++)
	{
		for (uint8_t i = X; i < X + Width; i ++)
		{
			//坐标(i, j) = 0
			OLED_DisplayBuf[j / 8][i] &= ~(0x01 << (j % 8));
		}
	}
}

void OLED_ShowChar(uint8_t X, uint8_t Y, char Char, uint8_t FontSize)
{
	if (FontSize == 6)
	{
		OLED_ShowImage(X, Y, 6, 8, OLED_F6x8[Char - ' ']);
	}
	else if (FontSize == 8)
	{
		OLED_ShowImage(X, Y, 8, 16, OLED_F8x16[Char - ' ']);
	}
}

void OLED_ShowString(uint8_t X, uint8_t Y, char *String, uint8_t FontSize)
{
	for (uint8_t i = 0; String[i] != '\0'; i ++)
	{
		OLED_ShowChar(X + i * FontSize, Y, String[i], FontSize);
	}
}

void OLED_ShowImage(uint8_t X, uint8_t Y, uint8_t Width, uint8_t Height, const uint8_t *Image)
{
	OLED_ClearArea(X, Y, Width, Height);
	
	for (uint8_t j = 0; j < (Height - 1) / 8 + 1; j ++)
	{
		for (uint8_t i = 0; i < Width; i ++)
		{
			OLED_DisplayBuf[Y / 8 + j][X + i] |= Image[j * Width + i] << (Y % 8);
			OLED_DisplayBuf[Y / 8 + j + 1][X + i] |= Image[j * Width + i] >> (8 - Y % 8);
		}
	}
}

void OLED_ShowChinese(uint8_t X, uint8_t Y, char *Chinese)
{
	char SigleChinese[4] = {0};
	uint8_t pChinese = 0;
	uint8_t pIndex;
	
	for (uint8_t i = 0; Chinese[i] != '\0'; i ++)
	{
		SigleChinese[pChinese] = Chinese[i];
		pChinese ++;
		
		if (pChinese >= 3)
		{
			pChinese = 0;
			
			for (pIndex = 0; strcmp(OLED_CF16x16[pIndex].Index, "") != 0; pIndex ++)
			{
				if (strcmp(OLED_CF16x16[pIndex].Index, SigleChinese) == 0)
				{
					break;
				}
			}
			
			OLED_ShowImage(X + ((i + 1) / 3 - 1) * 16, Y, 16, 16, OLED_CF16x16[pIndex].Data);
		}
	}
}

void OLED_DrawPoint(uint8_t X, uint8_t Y)
{
	OLED_DisplayBuf[Y / 8][X] |= 0x01 << (Y % 8);
}

uint8_t OLED_GetPoint(uint8_t X, uint8_t Y)
{
	if (OLED_DisplayBuf[Y / 8][X] & 0x01 << (Y % 8))
	{
		return 1;
	}
	return 0;
}

void OLED_DrawLine(uint8_t X0, uint8_t Y0, uint8_t X1, uint8_t Y1)
{
	float k = (float)(Y1 - Y0) / (X1 - X0);
	uint8_t temp;
	
	if (fabs(k) < 1)
	{
		if (X0 > X1)
		{
			temp = X0;
			X0 = X1;
			X1 = temp;
			
			temp = Y0;
			Y0 = Y1;
			Y1 = temp;
		}
		for (uint8_t x = X0; x <= X1; x ++)
		{
			OLED_DrawPoint(x, round(Y0 + (x - X0) * k));
		}
	}
	else
	{
		if (Y0 > Y1)
		{
			temp = X0;
			X0 = X1;
			X1 = temp;
			
			temp = Y0;
			Y0 = Y1;
			Y1 = temp;
		}
		for (uint8_t y = Y0; y <= Y1; y ++)
		{
			OLED_DrawPoint(round(X0 + (y - Y0) / k), y);
		}
	}
}
